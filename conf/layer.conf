## conf/layer.conf
```bitbake
# We have a conf and classes directory, add to BBPATH
BBPATH .= ":${LAYERDIR}"

# We have a packages directory, add to BBFILES
BBFILES += "${LAYERDIR}/recipes*/*/*.bb \
            ${LAYERDIR}/recipes*/*/*.bbappend"

BBFILE_COLLECTIONS += "iwave"
BBFILE_PATTERN_iwave := "^${LAYERDIR}/"
BBFILE_PRIORITY_iwave = "9"

LAYERSERIES_COMPAT_iwave = "sumo thud"
```

## conf/machine/imx6qdl-iwg15-sm.conf
```bitbake
#@TYPE: Machine
#@NAME: iWave i.MX6Q/DL iW-RainboW-G15
#@SOC: i.MX6Q/DL
#@DESCRIPTION: Machine configuration for iWave i.MX6Q/DL iW-RainboW-G15

MACHINEOVERRIDES =. "mx6iwave:mx6:mx6q:mx6dl:"

require conf/machine/include/imx-base.inc
require conf/machine/include/tune-cortexa9.inc
require include/dtb.inc

IMX_DEFAULT_KERNEL = "linux-fslc-imx"
IMX_DEFAULT_BSP = "nxp"

KERNEL_DEVICETREE = ""
KERNEL_IMAGETYPE = "zImage"

PREFERRED_PROVIDER_virtual/kernel = "linux-fslc-imx"

PREFERRED_PROVIDER_u-boot = "u-boot-imx"
PREFERRED_PROVIDER_virtual/bootloader = "u-boot-imx"
UBOOT_MACHINE ?= "mx6_iwg15m_sm_defconfig"

UBOOT_MAKE_TARGET = "u-boot.imx"
UBOOT_SUFFIX = "imx"

SERIAL_CONSOLES = "115200;ttymxc1"

MACHINE_ESSENTIAL_EXTRA_RDEPENDS += "device-tree"

MACHINE_FIRMWARE_append_mx6 = " linux-firmware-ath6k"

MACHINE_FEATURES += " bluetooth touchscreen"
```

## conf/machine/include/dtb.inc
```bitbake
IMAGE_BOOT_FILES ?= " \
    ${KERNEL_IMAGETYPE} \
    ${@get_dtb_boot_files(d)} \
    ${@bb.utils.contains('MACHINE_FEATURES', 'optee', '${OPTEE_BOOT_IMAGE}', '', d)} \
"

def get_dtb_boot_files(d):
    files = []

    # device trees (device-tree only), these are first as they are likely desired over the kernel ones
    if "device-tree" in (d.getVar("MACHINE_ESSENTIAL_EXTRA_RDEPENDS") or ""):
        files.append("devicetree/*.dtb")


    # Generate IMAGE_BOOT_FILES entries for device tree files listed in
    # KERNEL_DEVICETREE.
    # Use only the basename for dtb files:
    alldtbs = d.getVar('KERNEL_DEVICETREE')
    # device trees (kernel only)
    if alldtbs:
        dtbs = alldtbs.split(" ")
        dtbs = [os.path.basename(d) for d in dtbs]
        for dtb in dtbs:
            files.append(dtb)

    return " ".join(files)
```

## recipes-bsp/u-boot/files/configs/mx6_iwg15m_sm_defconfig
```kconfig
CONFIG_ARM=y
CONFIG_ARCH_MX6=y
CONFIG_TARGET_MX6_IWG15M_SM=y
CONFIG_USE_IMXIMG_PLUGIN=y
CONFIG_SYS_EXTRA_OPTIONS="IMX_CONFIG=board/freescale/mx6_iwg15m_sm/mx6_iwg15m.cfg"
CONFIG_BOOTDELAY=1
CONFIG_SILENT_CONSOLE=y
CONFIG_SYS_CONSOLE_OVERWRITE_ROUTINE=y
CONFIG_DEFAULT_FDT_FILE="imx6qd-iwg15m-sm_ldobypass.dtb"
CONFIG_HUSH_PARSER=y
CONFIG_CMD_BOOTZ=y
CONFIG_CMD_MEMTEST=y
# CONFIG_CMD_FLASH is not set
CONFIG_CMD_GPIO=y
CONFIG_CMD_I2C=y
CONFIG_CMD_MMC=y
CONFIG_CMD_SATA=y
CONFIG_CMD_USB=y
CONFIG_CMD_DHCP=y
CONFIG_CMD_MII=y
CONFIG_CMD_PING=y
CONFIG_CMD_CACHE=y
CONFIG_CMD_TIME=y
CONFIG_CMD_EXT2=y
CONFIG_CMD_EXT4=y
CONFIG_CMD_EXT4_WRITE=y
CONFIG_CMD_FAT=y
CONFIG_CMD_FS_GENERIC=y
CONFIG_ENV_IS_IN_SPI_FLASH=y
CONFIG_SYS_I2C_MXC=y
CONFIG_PHYLIB=y
CONFIG_PHY_MICREL=y
CONFIG_PHY_MICREL_KSZ90X1=y
CONFIG_NETDEVICES=y
CONFIG_FEC_MXC=y
CONFIG_MXC_UART=y
CONFIG_USB=y
CONFIG_USB_STORAGE=y
CONFIG_USB_HOST_ETHER=y
CONFIG_OF_LIBFDT=y
```

## recipes-bsp/u-boot/u-boot-imx/board/Kconfig
```kconfig
if TARGET_MX6_IWG15M_SM	

config SYS_BOARD
	default "mx6_iwg15m_sm"

config SYS_VENDOR
	default "freescale"

config SYS_SOC
	default "mx6"

config SYS_CONFIG_NAME
	default "mx6_iwg15m_sm"

config SYS_TEXT_BASE
	default 0x17800000

endif
```
