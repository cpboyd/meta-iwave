/*
 * Copyright (c) 2017-2018 iWave Systems Technologies Pvt. Ltd.
 *
 * The code contained herein is licensed under the GNU General Public
 * License. You may obtain a copy of the GNU General Public License
 * Version 2 or later at the following locations:
 *
 * http://www.opensource.org/licenses/gpl-license.html
 * http://www.gnu.org/copyleft/gpl.html
 */

#include "imx6dls-iwg15m-sm_ldobypass.dts"

&gpc {
	fsl,ldo-bypass = <0>; /* use ldo-bypass, u-boot will check it and configure */
};

&reg_arm {
	/delete-property/ vin-supply;
};

&reg_pu {
	/delete-property/ vin-supply;
};

&reg_soc {
	/delete-property/ vin-supply;
};
